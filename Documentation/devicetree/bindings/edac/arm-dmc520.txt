## Documentation/devicetree/bindings/edac/arm-dmc520.txt
```
* ARM DMC-520 EDAC node

Required properties:
- compatible		: "brcm,dmc-520", "arm,dmc-520".
- reg			: Address range of the DMC-520 registers.
- interrupts		: DMC-520 interrupt numbers. The example below specifies
			  two interrupt lines for dram_ecc_errc_int and
			  dram_ecc_errd_int.
- interrupt-config	: This is an array of interrupt masks. For each of the
			  above interrupt line, add one interrupt mask element to
			  it. That is, there is a 1:1 mapping from each interrupt
			  line to an interrupt mask. An interrupt mask can represent
			  multiple interrupts being enabled. Refer to interrupt_control
			  register in DMC-520 TRM for interrupt mapping. In the example
			  below, the interrupt configuration enables dram_ecc_errc_int
			  and dram_ecc_errd_int. And each interrupt is connected to
			  a separate interrupt line.

Example:

dmc0: dmc@200000 {
	compatible = "brcm,dmc-520", "arm,dmc-520";
	reg = <0x200000 0x80000>;
	interrupts = <0x0 0x349 0x4>, <0x0 0x34B 0x4>;
	interrupt-config = <0x4>, <0x8>;
};
```

## drivers/gpu/dxgkrnl/Kconfig
```kconfig
#
# dxgkrnl configuration
#

config DXGKRNL
	tristate "Microsoft virtual GPU support"
	depends on HYPERV
	help
	  This driver supports Microsoft virtual GPU.
```

## drivers/hv/dxgkrnl/Kconfig
```kconfig
# SPDX-License-Identifier: GPL-2.0
# Configuration for the hyper-v virtual compute driver (dxgkrnl)
#

config DXGKRNL
	tristate "Microsoft Paravirtualized GPU support"
	depends on HYPERV
	depends on 64BIT || COMPILE_TEST
	select DMA_SHARED_BUFFER
	select SYNC_FILE
	help
	  This driver supports paravirtualized virtual compute devices, exposed
	  by Microsoft Hyper-V when Linux is running inside of a virtual machine
	  hosted by Windows. The virtual machines needs to be configured to use
	  host compute adapters. The driver name is dxgkrnl.

	  An example of such virtual machine is a  Windows Subsystem for
	  Linux container. When such container is instantiated, the Windows host
	  assigns compatible host GPU adapters to the container. The corresponding
	  virtual GPU devices appear on the PCI bus in the container. These
	  devices are enumerated and accessed by this driver.

	  Communications with the driver are done by using the Microsoft libdxcore
	  library, which translates the D3DKMT interface
	  <https://docs.microsoft.com/en-us/windows-hardware/drivers/ddi/d3dkmthk/>
	  to the driver IOCTLs. The virtual GPU devices are paravirtualized,
	  which means that access to the hardware is done in the host. The driver
	  communicates with the host using Hyper-V VM bus communication channels.
```

## drivers/soc/bcm/Kconfig
```kconfig
# SPDX-License-Identifier: GPL-2.0-only
menu "Broadcom SoC drivers"

config BCM2835_POWER
	bool "BCM2835 power domain driver"
	depends on ARCH_BCM2835 || (COMPILE_TEST && OF)
	default y if ARCH_BCM2835
	select PM_GENERIC_DOMAINS if PM
	select RESET_CONTROLLER
	help
	  This enables support for the BCM2835 power domains and reset
	  controller.  Any usage of power domains by the Raspberry Pi
	  firmware means that Linux usage of the same power domain
	  must be accessed using the RASPBERRYPI_POWER driver

config RASPBERRYPI_POWER
	bool "Raspberry Pi power domain driver"
	depends on ARCH_BCM2835 || (COMPILE_TEST && OF)
	depends on RASPBERRYPI_FIRMWARE=y
	select PM_GENERIC_DOMAINS if PM
	help
	  This enables support for the RPi power domains which can be enabled
	  or disabled via the RPi firmware.

config SOC_BRCMSTB
	bool "Broadcom STB SoC drivers"
	depends on ARM || ARM64 || BMIPS_GENERIC || COMPILE_TEST
	select SOC_BUS
	help
	  Enables drivers for the Broadcom Set-Top Box (STB) series of chips.
	  This option alone enables only some support code, while the drivers
	  can be enabled individually within this menu.

	  If unsure, say N.

config SOC_BRCM_IPROC
	bool "Broadcom iProc SoC drivers"
	depends on ARCH_BCM_IPROC || COMPILE_TEST
	default ARCH_BCM_IPROC
	help
	  Enable SoC drivers for Broadcom iProc based chipsets

	  If unsure, say N.

source "drivers/soc/bcm/brcmstb/Kconfig"
source "drivers/soc/bcm/iproc/Kconfig"

endmenu
```

## drivers/soc/bcm/iproc/Kconfig
```kconfig
config IPROC_IDM
	bool "Broadcom iProc IDM driver"
	depends on (ARCH_BCM_IPROC || COMPILE_TEST) && OF
	default ARCH_BCM_IPROC
	help
	  Enables support for iProc Interconnect and Device Management (IDM) control and monitoring
```

## lib/raid6/Kconfig
```kconfig
menu "RAID 6"

config RAID6_PQ
	tristate

config RAID6_FORCE_ALGO
	bool "Always use specified recovery algorithm"
	default n
	depends on RAID6_PQ
	help
		If this option is not set, on every boot the kernel will
		benchmark each optimized version of the RAID6 recovery and
		syndrome generation algorithms and will select the one that
		performs best. Microbenchmarking each version negatively
		affects boot time.

		Enabling this option skips the benchmark at boot, and
		instead always uses the algorithm selected. The only exception
		is if the selected algorithm relies on a cpu feature not
		supported at runtime. In this case, one of the lower performance
		fallbacks are used.

choice
	prompt "RAID6 Recovery Algorithm"
	default RAID6_FORCE_INT
	depends on RAID6_FORCE_ALGO
	---help---
		Select the RAID6 recovery algorithm to unconditionally use

	config RAID6_FORCE_INT
		bool "Reference Implementation"
	config RAID6_FORCE_SSSE3
		bool "SSSE3"
	config RAID6_FORCE_AVX2
		bool "AVX2"
endchoice

endmenu
```
