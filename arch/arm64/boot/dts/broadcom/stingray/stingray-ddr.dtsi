// SPDX-License-Identifier: (GPL-2.0 or BSD-3-Clause)
/*
 * Copyright(c) 2019 Broadcom
 */

ddr {
	compatible = "simple-bus";
	#address-cells = <1>;
	#size-cells = <1>;
	ranges = <0x0 0x0 0x66200000 0x200000>;

	dmc0: dmc@00000 {
		compatible = "brcm,dmc-520", "arm,dmc-520";
		reg = <0x00000000 0x2000>;
		interrupts = <GIC_SPI 841 IRQ_TYPE_LEVEL_HIGH>,
			     <GIC_SPI 843 IRQ_TYPE_LEVEL_HIGH>;
		interrupt-config = <0x4>, <0x8>;
	};

	dmc1: dmc@80000 {
		compatible = "brcm,dmc-520", "arm,dmc-520";
		reg = <0x00080000 0x2000>;
		interrupts = <GIC_SPI 871 IRQ_TYPE_LEVEL_HIGH>,
			     <GIC_SPI 873 IRQ_TYPE_LEVEL_HIGH>;
		interrupt-config = <0x4>, <0x8>;
	};

	dmc2: dmc@100000 {
		compatible = "brcm,dmc-520", "arm,dmc-520";
		reg = <0x00100000 0x2000>;
		interrupts = <GIC_SPI 901 IRQ_TYPE_LEVEL_HIGH>,
			     <GIC_SPI 903 IRQ_TYPE_LEVEL_HIGH>;
		interrupt-config = <0x4>, <0x8>;
	};
};
